## auto_watering/main/Kconfig.projbuild
```kconfig
menu "Auto watering configuration"

config AUTO_WATERING_ENABLE_AUTOMATION
    bool "Enable automatic watering"
    default y

config AUTO_WATERING_ENABLE_ZIGBEE
    bool "Enable Zigbee resource publishing hooks"
    default n

config AUTO_WATERING_SAMPLE_PERIOD_MS
    int "Sensor sample period (ms)"
    range 1000 60000
    default 5000

config AUTO_WATERING_FILTER_ALPHA_PCT
    int "Filter alpha percent"
    range 1 100
    default 25

config AUTO_WATERING_DRY_THRESHOLD_PCT
    int "Dry threshold percent"
    range 0 100
    default 35

config AUTO_WATERING_WET_REFERENCE_RAW
    int "Wet calibration raw ADC reference"
    range 0 4095
    default 1200

config AUTO_WATERING_DRY_REFERENCE_RAW
    int "Dry calibration raw ADC reference"
    range 0 4095
    default 2800

config AUTO_WATERING_PUMP_GPIO
    int "Pump MOSFET GPIO"
    range 0 31
    default 10

config AUTO_WATERING_PUMP_MAX_RUNTIME_MS
    int "Pump max runtime (ms)"
    range 100 600000
    default 5000

config AUTO_WATERING_PUMP_LOCKOUT_MS
    int "Pump lockout after run (ms)"
    range 0 3600000
    default 60000

config AUTO_WATERING_AUTO_WATER_RUNTIME_MS
    int "Automatic watering runtime (ms)"
    range 100 600000
    default 3000

endmenu
```

## auto_watering/sdkconfig.defaults
```kconfig
# Partition Table
CONFIG_PARTITION_TABLE_CUSTOM=y
CONFIG_PARTITION_TABLE_CUSTOM_FILENAME="partitions.csv"
CONFIG_PARTITION_TABLE_FILENAME="partitions.csv"
CONFIG_PARTITION_TABLE_OFFSET=0x8000
CONFIG_PARTITION_TABLE_MD5=y

# Flash size (Waveshare ESP32-H2-Zero has 4 MB)
# Keep image header in sync with the real chip size to avoid boot warnings.
# CONFIG_ESPTOOLPY_FLASHSIZE_2MB is not set
CONFIG_ESPTOOLPY_FLASHSIZE_4MB=y
CONFIG_ESPTOOLPY_FLASHSIZE="4MB"

# Zigbee End Device
CONFIG_ZB_ENABLED=y
CONFIG_ZB_ZED=y

# mbedTLS required for Zigbee CBKE
CONFIG_MBEDTLS_HARDWARE_AES=n
CONFIG_MBEDTLS_HARDWARE_MPI=n
CONFIG_MBEDTLS_HARDWARE_SHA=n
CONFIG_MBEDTLS_CMAC_C=y
CONFIG_MBEDTLS_SSL_PROTO_DTLS=y
CONFIG_MBEDTLS_KEY_EXCHANGE_ECJPAKE=y
CONFIG_MBEDTLS_ECJPAKE_C=y
```
